## configs/qemu_riscv64_virt_defconfig
```kconfig
BR2_riscv=y
BR2_GLOBAL_PATCH_DIR="board/qemu/patches"
BR2_DOWNLOAD_FORCE_CHECK_HASHES=y
BR2_SYSTEM_DHCP="eth0"
BR2_ENABLE_LOCALE_WHITELIST="C en_US.UTF-8"
BR2_TARGET_TZ_INFO=y
BR2_ROOTFS_OVERLAY="board/lynx/"
BR2_ROOTFS_POST_IMAGE_SCRIPT="board/qemu/post-image.sh"
BR2_ROOTFS_POST_SCRIPT_ARGS="$(BR2_DEFCONFIG)"
BR2_PACKAGE_BLKTRACE=y
BR2_PACKAGE_BPFTOOL=y
BR2_PACKAGE_CACHE_CALIBRATOR=y
BR2_PACKAGE_FIO=y
BR2_PACKAGE_KEXEC=y
BR2_PACKAGE_KVM_UNIT_TESTS=y
BR2_PACKAGE_LIBBPF=y
BR2_PACKAGE_MEMSTAT=y
BR2_PACKAGE_PERFTEST=y
BR2_PACKAGE_RT_TESTS=y
BR2_PACKAGE_STRACE=y
BR2_PACKAGE_STRESS=y
BR2_PACKAGE_STRESS_NG=y
BR2_PACKAGE_TRACE_CMD=y
BR2_PACKAGE_UCLIBC_NG_TEST=y
BR2_PACKAGE_NVME=y
BR2_PACKAGE_SYSSTAT=y
BR2_PACKAGE_LIBXCRYPT=y
BR2_PACKAGE_LIBCONFUSE=y
BR2_PACKAGE_JSON_GLIB=y
BR2_PACKAGE_GCONF=y
BR2_PACKAGE_NCURSES_WCHAR=y
BR2_PACKAGE_NCURSES_TARGET_PROGS=y
BR2_PACKAGE_READLINE=y
# BR2_PACKAGE_IFUPDOWN_SCRIPTS is not set
BR2_TARGET_ROOTFS_CPIO=y
BR2_TARGET_ROOTFS_CPIO_GZIP=y
BR2_TARGET_ROOTFS_EXT2=y
BR2_TARGET_ROOTFS_EXT2_4=y
BR2_TARGET_ROOTFS_EXT2_SIZE="1024M"
BR2_TARGET_OPENSBI=y
BR2_TARGET_OPENSBI_CUSTOM_VERSION=y
BR2_TARGET_OPENSBI_CUSTOM_VERSION_VALUE="1.6"
BR2_TARGET_OPENSBI_PLAT="generic"
```
